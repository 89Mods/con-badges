lcd_cmd_nop equ 0x00
lcd_cmd_soft_reset equ 0x01
lcd_cmd_exit_sleep_mode equ 0x11
lcd_cmd_enter_normal_mode equ 0x13
lcd_cmd_set_display_off equ 0x28
lcd_cmd_set_display_on equ 0x29
lcd_cmd_set_column_address equ 0x2A
lcd_cmd_set_page_address equ 0x2B
lcd_cmd_write_memory_start equ 0x2C
lcd_cmd_set_address_mode equ 0x36
lcd_cmd_set_pixel_data_interface equ 0xF0

lcd_width equ 800
lcd_height equ 480

term_scale equ 2
term_char_width equ (7*term_scale)
term_width equ (lcd_width / term_char_width - 1)
term_char_height equ (10*term_scale)
term_height equ (lcd_height / term_char_height)
term_margin equ 5
character_width equ 7
character_height equ 8

lcd_busy_wait:
	push eax
	mov dx,cpld_base+(6<<2)
lcd_busy_wait_loop:
	in eax,dx
	test al,8
	jnz lcd_busy_wait_loop
	pop eax
	ret

lcd_push:
	mov dx,cpld_base+(6<<2)
lcd_busy_wait2:
	in eax,dx
	test al,8
	jnz lcd_busy_wait2
	mov eax,lcd_cmd_set_column_address
	out dx,eax
	mov eax,0x00 | (1 << 23)
	out dx,eax
	nop
	out dx,eax
	mov eax,0x03 | (1 << 23)
	out dx,eax
	mov eax,0x1F | (1 << 23)
	out dx,eax
	mov eax,lcd_cmd_set_page_address
	out dx,eax
	mov eax,0x00 | (1 << 23)
	out dx,eax
	nop
	out dx,eax
	mov eax,0x01 | (1 << 23)
	out dx,eax
	mov eax,0xDF | (1 << 23)
	out dx,eax
	
	mov dx,cpld_lcd_cmd
	mov eax,lcd_cmd_write_memory_start
	out dx,eax
	mov dx,cpld_lcd_copy
	out dx,eax
	ret

	; Clear color in eax
lcd_clear:
	call lcd_busy_wait
	push ebx
	push eax
	mov ebx,eax
	xor eax,eax
	mov dx,cpld_ptr
	out dx,eax
	mov eax,ebx
	mov ebx,800*480
	mov dx,cpld_pxdata
lcd_clear_loop:
	out dx,eax
	dec ebx
	jnz lcd_clear_loop
	xor eax,eax
	mov dx,cpld_ptr
	out dx,eax
	pop eax
	pop ebx
	ret

	; str ptr in eax
	; scale in bl
	; Initial screen addr in edx
draw_string:
	push eax
	push ebx
	push ecx
	push edx
	push esi
	enter 8,0
	mov esi,eax
	
	mov byte [ebp-6],0
	mov [ebp-5],bl
	mov dword [ebp-4],0
draw_string_line_loop_outer:

	mov cl,[ebp-5]
draw_string_line_loop_inner:
	mov eax,edx
	mov dx,cpld_ptr
	out dx,eax
	push eax
	push esi
draw_string_char_loop:
	xor edx,edx
	mov dl,fs:[esi]
	inc esi
	cmp dl,0
	je draw_string_done
	cmp dl,' '
	jge draw_string_char_okay
	mov dl,'?'
draw_string_char_okay:
	sub dl,' '
	shl edx,3
    or dl,[ebp-6]
	add edx,font
	mov bl,cs:[edx]
	mov bh,character_width
	mov dx,cpld_pxdata
draw_string_putpixel_outer:
		mov eax,[term_bg]
		shr bl,1
		jnc draw_string_pixel_clear
		mov eax,[term_fg]
	draw_string_pixel_clear:
		mov ch,[ebp-5]
	draw_string_putpixel_inner:
			out dx,eax
			dec ch
			jnz draw_string_putpixel_inner
		dec bh
		jnz draw_string_putpixel_outer
	jmp draw_string_char_loop
draw_string_done:
	pop esi
	pop edx
	add edx,lcd_width
	dec cl
	jnz draw_string_line_loop_inner
	mov cl,[ebp-6]
	inc cl
	mov [ebp-6],cl
	cmp cl,8
	jne draw_string_line_loop_outer

	leave
	pop esi
	pop edx
	pop ecx
	pop ebx
	pop eax
	ret

	; Char in bl
term_putchar:
	call lcd_busy_wait
	push eax
	push ebx
	push ecx
	push edx
	push esi
	push ebp
	
	mov bh,[term_cx]
	mov cl,[term_cy]
	cmp bl,10
	je term_newl
	cmp bl,13
	je term_cr
	
	cmp bh,term_width
	jne term_no_newl
term_newl:
	xor bh,bh
	inc cl
	mov [term_cy],cl
	mov [term_cx],bh
	jmp term_no_newl
term_cr:
	xor bh,bh
	mov [term_cx],bh
	jmp term_putchar_ret
term_no_newl:
	cmp bl,10
	je term_putchar_ret
	; New disp pointer address is ((cy * term_char_height + term_margin) * lcd_width + cx * term_char_width + term_margin
	xor eax,eax
	mov al,cl
	mov edx,term_char_height
	mul edx
	add eax,term_margin
	mov edx,lcd_width
	mul edx
	mov esi,eax
	xor eax,eax
	mov al,bh
	mov edx,term_char_width
	mul edx
	add eax,term_margin
	add eax,esi
	mov esi,eax
	
	inc bh
	mov [term_cx],bh
	and ebx,0xFF
	
	cmp bl,' '
	jge term_char_okay
	mov bl,'?'
term_char_okay:
	sub bl,' '
	shl ebx,3
	mov ebp,font
	add ebp,ebx
	
	mov bh,8
term_char_loop_rows:
	mov cl,term_scale
	push bx
term_char_loop_outer:
	mov eax,esi
	mov dx,cpld_ptr
	out dx,eax
	mov ch,cs:[ebp]
	mov bh,character_width
term_char_loop_inner:
	mov eax,[term_bg]
	shr ch,1
	jnc term_char_pixel_clear
	mov eax,[term_fg]
term_char_pixel_clear:
	mov bl,term_scale
	mov dx,cpld_pxdata
term_char_pixel_repeat:
	out dx,eax
	dec bl
	jnz term_char_pixel_repeat
	dec bh
	jnz term_char_loop_inner
	add esi,lcd_width
	dec cl
	jnz term_char_loop_outer
	inc ebp
	pop bx
	dec bh
	jnz term_char_loop_rows
	
term_putchar_ret:
	pop ebp
	pop esi
	pop edx
	pop ecx
	pop ebx
	pop eax
	ret

	; Pointer in eax
term_putstring:
	push ebx
	mov ebx,0
term_putstring_loop:
	mov bl,fs:[eax]
	test bl,0xFF
	jz putstring_done
	inc eax
	call term_putchar
	jmp term_putstring_loop

	; Value in al
term_puthex_byte:
	push ebx
	push eax
	mov ebx,hexchars
	shr al,4
	and eax,15
	add ebx,eax
	mov ebx,cs:[ebx]
	call term_putchar
	pop eax
	and eax,15
	mov ebx,hexchars
	add ebx,eax
	mov ebx,cs:[ebx]
	call term_putchar
	pop ebx
	ret

	; Value in eax
term_puthex:
	push eax
	shr eax,24
	call term_puthex_byte
	mov eax,ss:[esp]
	shr eax,16
	call term_puthex_byte
	mov eax,ss:[esp]
	shr eax,8
	call term_puthex_byte
	mov eax,ss:[esp]
	call term_puthex_byte
	pop eax
	ret

	; Pointer in eax
term_putfatal:
	push eax
	push ebx
	mov eax,[term_fg]
	push eax
	xor ebx,ebx
	mov bl,'['
	call term_putchar
	mov dword [term_fg],0xFF0000
	mov bl,'F'
	call term_putchar
	mov bl,'A'
	call term_putchar
	mov bl,'T'
	call term_putchar
	mov bl,'A'
	call term_putchar
	mov bl,'L'
	call term_putchar
	pop eax
	mov [term_fg],eax
	mov bl,']'
	call term_putchar
	mov bl,' '
	call term_putchar
	pop ebx
	pop eax
	jmp term_putstring

	; Pointer in eax
term_putwarn:
	push eax
	push ebx
	mov eax,[term_fg]
	push eax
	xor ebx,ebx
	mov bl,'['
	call term_putchar
	mov dword [term_fg],0xF0D000
	mov bl,'W'
	call term_putchar
	mov bl,'A'
	call term_putchar
	mov bl,'R'
	call term_putchar
	mov bl,'N'
	call term_putchar
	pop eax
	mov [term_fg],eax
	mov bl,']'
	call term_putchar
	mov bl,' '
	call term_putchar
	pop ebx
	pop eax
	jmp term_putstring

	; Pointer in eax
term_putinfo:
	push eax
	push ebx
	mov eax,[term_fg]
	push eax
	xor ebx,ebx
	mov bl,'['
	call term_putchar
	mov dword [term_fg],0x179bed
	mov bl,'I'
	call term_putchar
	mov bl,'N'
	call term_putchar
	mov bl,'F'
	call term_putchar
	mov bl,'O'
	call term_putchar
	pop eax
	mov [term_fg],eax
	mov bl,']'
	call term_putchar
	mov bl,' '
	call term_putchar
	pop ebx
	pop eax
	jmp term_putstring

font:
	db 0x00,0x00,0x00,0x00,0x00,0x00,0x00,0x00
	db 0x04,0x04,0x04,0x04,0x04,0x04,0x00,0x04
	db 0x0a,0x0a,0x0a,0x00,0x00,0x00,0x00,0x00
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	db 0x00,0x00,0x00,0x12,0x15,0x09,0x00,0x00
